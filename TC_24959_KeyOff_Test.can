/*
===============================================================================
  TEST CASE: TC_24959 - TC_F040_NBC_VehicleSts_Comfort_KeyOff
  Description: Vehicle Status - Comfort Mode - Key Off Test
  
===============================================================================
  SIGNAL MAPPING & NOTES:
===============================================================================
  
  FOUND SIGNALS (Actual signals from DBC/A2L files):
  ─────────────────────────────────────────────────
  ✓ IgnPosSts            - From RFHUB1 (Message 359) in BH_CAN
  ✓ EngineSts            - From STATUS_SGW (Message 1441) in ACCESS_CAN
  ✓ StopStartSts         - From STATUS_SGW (Message 1441) in ACCESS_CAN  
  ✓ HMISts               - From HMI_INFO (Message 1035) in ACCESS_CAN/BH_CAN
  ✓ PowertrainSts        - From STATUS_SGW (Message 1441) in ACCESS_CAN
  ✓ STS_LH_DoorStatus    - From STS_LH_DoorStatus_MSG (Message 971) in BH_CAN
  ✓ STS_RH_DoorStatus    - From STS_RH_DoorStatus_MSG (Message 972) in BH_CAN
  ✓ VehicleSts           - From STATUS_NBC_3 (Message 961) in BH_CAN
  ✓ UserPresence         - From STATUS_NBC_3 (Message 961) in BH_CAN
  ✓ NFR_Speed_FA         - From NFR_SPEED (Message 524) in ACCESS_CAN/BH_CAN
  ✓ NFR_Speed_FA_FailSts - From NFR_SPEED (Message 524) in ACCESS_CAN/BH_CAN
  ✓ EXT_LGH_ParkingLightCmd - From EXTERNAL_LIGHTS (Message 384) in BH_CAN
  
  NOT FOUND (Commented out - not available in databases):
  ───────────────────────────────────────────────────
  ✗ Proxy_write_Power_Unit_Extended - Signal not found in DBC/A2L files
  ✗ si_sys_TcSen_bTerm15_1          - Signal not found in DBC/A2L files
  ✗ si_sys_TcSen_bTerm15_2          - Signal not found in DBC/A2L files
  ✗ si_sys_TcSen_bTermS             - Signal not found in DBC/A2L files
  ✗ so_sys_F040_KeySts_BODYCAN      - Alternative found: KeySts (Msg 1376 ACCESS_CAN)
  ✗ so_sys_F040_KeySts_ACCESSCAN    - Alternative found: KeySts (Msg 1376 ACCESS_CAN)
  ✗ so_sys_F040_KeySts_BHCAN        - Multiple KeySts signals - requires mapping

===============================================================================
  TEST STRUCTURE:
===============================================================================
  PRE-CONDITION    : Initial state configuration
  STIMULATION-1    : Apply test conditions 1
  EXPECTED-1       : Verify expected results after condition 1
  STIMULATION-2    : Apply parking light command (0.5 sec delay)
  EXPECTED-2       : Verify expected results after condition 2
  POST-CONDITION   : Cleanup and reset
  
===============================================================================
*/

includes

variables
{
  // Test execution counters and status
  dword g_TestStartTime;
  dword g_StimulationTime;
  int g_TestStatus;
  
  // Test phase tracking
  int g_CurrentPhase = 0;  // 0=Init, 1=PreCond, 2=Stim1, 3=Check1, 4=Stim2, 5=Check2, 6=PostCond
}

/*
===============================================================================
  TEST INITIALIZATION
===============================================================================
*/
testcase TC_24959_KeyOff_Test()
{
  dword startTime;
  
  Write(">>> Starting TC_24959 - Vehicle Status Comfort Key Off Test");
  Write(">>> Test Case: TC_F040_NBC_VehicleSts_Comfort_KeyOff");
  Write("");
  
  g_TestStartTime = GetTickCount();
  g_TestStatus = 0;  // 0 = Pass, 1 = Fail
  
  
  // =========================================================================
  // PHASE 1: PRE-CONDITION - Set initial conditions
  // =========================================================================
  g_CurrentPhase = 1;
  Write(">>> PHASE 1: PRE-CONDITION");
  Write("Setting initial vehicle state configuration...");
  
  // NOTE: Proxy_write_Power_Unit_Extended - Signal NOT FOUND in DBC files
  // Write("   - Setting Proxy_write_Power_Unit_Extended = 2 (EV)");
  // This signal is not available in the provided DBC/A2L files
  
  // NOTE: si_sys_TcSen_bTerm15_1 - Signal NOT FOUND
  // NOTE: si_sys_TcSen_bTerm15_2 - Signal NOT FOUND  
  // NOTE: si_sys_TcSen_bTermS - Signal NOT FOUND
  // These term15 signals are not available in the provided databases
  
  // Set NFR Speed signals (from NFR_SPEED message 524)
  Write("   - Setting NFR_Speed_FA = 0 km/h");
  NFR_SPEED.NFR_Speed_FA = 0;
  
  Write("   - Setting NFR_Speed_FA_FailSts = 0 (No failure)");
  NFR_SPEED.NFR_Speed_FA_FailSts = 0;
  
  // Set Engine Status signals (from STATUS_SGW message 1441)
  Write("   - Setting StopStartSts = 0 (Off)");
  STATUS_SGW.StopStartSts = 0;
  
  Write("   - Setting EngineSts = 0 (Engine_OFF)");
  STATUS_SGW.EngineSts = 0;
  
  // Set Door Status signals (from STS_LH_DoorStatus_MSG message 971)
  Write("   - Setting STS_LH_DoorStatus = 1 (Closed)");
  STS_LH_DoorStatus_MSG.STS_LH_DoorStatus = 1;
  
  // Set Ignition Position (from RFHUB1 message 359)
  Write("   - Setting IgnPosSts = 1 (ACC/Run)");
  RFHUB1.IgnPosSts = 1;
  
  // Set PowerTrain Status (from STATUS_SGW message 1441)
  Write("   - Setting PowertrainSts = 0");
  STATUS_SGW.PowertrainSts = 0;
  
  Write("");
  Write(">>> Pre-condition setup complete");
  Write("");
  Wait(100);  // Small delay to ensure signals settle
  
  
  // =========================================================================
  // PHASE 2: STIMULATION-1 - Apply first set of test conditions
  // =========================================================================
  g_CurrentPhase = 2;
  Write(">>> PHASE 2: STIMULATION-1");
  Write("Applying first test stimulation conditions...");
  
  // Set conditions from STIMULATION-1 section
  Write("   - Setting STS_LH_DoorStatus = 3 (Opened)");
  STS_LH_DoorStatus_MSG.STS_LH_DoorStatus = 3;
  
  Write("   - Setting IgnPosSts = 1 (ACC/Run position)");
  RFHUB1.IgnPosSts = 1;
  
  Write("   - Setting PowertrainSts = 0");
  STATUS_SGW.PowertrainSts = 0;
  
  // NOTE: si_sys_SGW_HMISts signal name - actual signal is HMISts
  Write("   - Setting HMISts = 1 (HMI_ON)");
  HMI_INFO.HMISts = 1;
  
  g_StimulationTime = GetTickCount();
  Write("");
  Write(">>> Stimulation-1 applied");
  Write("");
  Wait(100);
  
  
  // =========================================================================
  // PHASE 3: CHECK EXPECTED RESULTS-1
  // =========================================================================
  g_CurrentPhase = 3;
  Write(">>> PHASE 3: CHECKING EXPECTED RESULTS-1");
  Write("Verifying vehicle state after Stimulation-1...");
  Write("");
  
  // Check VehicleSts transition: 0->1 (Wake_Up -> Comfort)
  Write("   ✓ Expected: VehicleSts = 0->1 (Wake_Up -> Comfort)");
  Write("     Actual: VehicleSts = %d", STATUS_NBC_3.VehicleSts);
  if (STATUS_NBC_3.VehicleSts == 1) {
    Write("     Status: PASS");
  } else {
    Write("     Status: FAIL");
    g_TestStatus = 1;
  }
  Write("");
  
  // Check UserPresence transition: 0->2
  Write("   ✓ Expected: UserPresence = 0->2");
  Write("     Actual: UserPresence = %d", STATUS_NBC_3.UserPresence);
  if (STATUS_NBC_3.UserPresence == 2) {
    Write("     Status: PASS");
  } else {
    Write("     Status: FAIL");
    g_TestStatus = 1;
  }
  Write("");
  
  // NOTE: KeySts signals are complex and may need separate mapping for each CAN bus
  // so_sys_F040_KeySts_BODYCAN, _ACCESSCAN, _BHCAN - Alternative approach:
  // These would typically be in different messages on different CAN networks
  Write("   ⚠ NOTE: so_sys_F040_KeySts_* signals require mapping to specific CAN messages");
  Write("     - Potential mapping: Message 1376 (STATUS_B_CAN) contains KeySts signal");
  Write("");
  
  Write(">>> Expected Results-1 verification complete");
  Write("");
  Wait(500);
  
  
  // =========================================================================
  // PHASE 4: STIMULATION-2 - Set parking light command
  // =========================================================================
  g_CurrentPhase = 4;
  Write(">>> PHASE 4: STIMULATION-2");
  Write("Setting parking light command and waiting 0.5 seconds...");
  
  // NOTE: si_sys_NPS_ParkingLightsCommand - actual signal is EXT_LGH_ParkingLightCmd
  Write("   - Setting EXT_LGH_ParkingLightCmd = 0 (Off)");
  EXTERNAL_LIGHTS.EXT_LGH_ParkingLightCmd = 0;
  
  Write("   - Waiting 0.5 seconds for state transition...");
  Wait(500);  // 0.5 second delay as specified in test
  
  Write("");
  Write(">>> Stimulation-2 applied");
  Write("");
  
  
  // =========================================================================
  // PHASE 5: CHECK EXPECTED RESULTS-2
  // =========================================================================
  g_CurrentPhase = 5;
  Write(">>> PHASE 5: CHECKING EXPECTED RESULTS-2");
  Write("Verifying vehicle state after Stimulation-2...");
  Write("(Check if Key status transitions to PARK)");
  Write("");
  
  // Expected Results-2: Check vehicle status remains stable
  Write("   ✓ Expected: VehicleSts = 1 (Comfort state)");
  Write("     Actual: VehicleSts = %d", STATUS_NBC_3.VehicleSts);
  if (STATUS_NBC_3.VehicleSts == 1) {
    Write("     Status: PASS");
  } else {
    Write("     Status: FAIL");
    g_TestStatus = 1;
  }
  Write("");
  
  // Expected Results-2: Check UserPresence remains stable
  Write("   ✓ Expected: UserPresence = 2");
  Write("     Actual: UserPresence = %d", STATUS_NBC_3.UserPresence);
  if (STATUS_NBC_3.UserPresence == 2) {
    Write("     Status: PASS");
  } else {
    Write("     Status: FAIL");
    g_TestStatus = 1;
  }
  Write("");
  
  Write("   ⚠ NOTE: so_sys_F040_KeySts_* signals transitions (1->2) require CAN message mapping");
  Write("");
  
  Write(">>> Expected Results-2 verification complete");
  Write("");
  
  
  // =========================================================================
  // PHASE 6: POST-CONDITION - Cleanup
  // =========================================================================
  g_CurrentPhase = 6;
  Write(">>> PHASE 6: POST-CONDITION");
  Write("Resetting vehicle to initial state...");
  Write("");
  
  // NOTE: Resetting term15 signals - these signals not available in databases
  // si_sys_TcSen_bTerm15_1 = 0
  // si_sys_TcSen_bTerm15_2 = 0
  // si_sys_TcSen_bTermS = 0
  
  // Reset parking light command
  Write("   - Resetting EXT_LGH_ParkingLightCmd = 0");
  EXTERNAL_LIGHTS.EXT_LGH_ParkingLightCmd = 0;
  
  // Reset NFR Speed
  Write("   - Resetting NFR_Speed_FA = 0");
  NFR_SPEED.NFR_Speed_FA = 0;
  
  Write("   - Resetting NFR_Speed_FA_FailSts = 0");
  NFR_SPEED.NFR_Speed_FA_FailSts = 0;
  
  // Reset Stop/Start
  Write("   - Resetting StopStartSts = 0");
  STATUS_SGW.StopStartSts = 0;
  
  // Reset Engine
  Write("   - Resetting EngineSts = 0");
  STATUS_SGW.EngineSts = 0;
  
  // Reset Door
  Write("   - Resetting STS_LH_DoorStatus = 1");
  STS_LH_DoorStatus_MSG.STS_LH_DoorStatus = 1;
  
  // Reset Ignition
  Write("   - Resetting IgnPosSts = 1");
  RFHUB1.IgnPosSts = 1;
  
  // Reset PowerTrain
  Write("   - Resetting PowertrainSts = 0");
  STATUS_SGW.PowertrainSts = 0;
  
  Write("");
  Write(">>> Post-condition cleanup complete");
  Write("");
  
  
  // =========================================================================
  // TEST SUMMARY
  // =========================================================================
  Write("");
  Write("═══════════════════════════════════════════════════════════════");
  Write("TEST EXECUTION SUMMARY");
  Write("═══════════════════════════════════════════════════════════════");
  
  dword elapsedTime = GetTickCount() - g_TestStartTime;
  Write("Test Case:        TC_24959 - NBC Vehicle Status Comfort Key Off");
  Write("Test Duration:    %d ms", elapsedTime);
  Write("Execution Phases: Pre-Condition -> Stimulation-1 -> Check-1 ->>");
  Write("                  Stimulation-2 -> Check-2 -> Post-Condition");
  Write("");
  
  if (g_TestStatus == 0) {
    Write("TEST RESULT: PASS");
  } else {
    Write("TEST RESULT: FAIL");
  }
  
  Write("");
  Write("SIGNAL MAPPING NOTES:");
  Write("─────────────────────");
  Write("• Test uses actual CAN signal names from:");
  Write("  - ACCESS_CAN.dbc  : EngineSts, StopStartSts, HMISts, PowertrainSts, NFR_Speed_*");
  Write("  - BH_CAN.dbc      : VehicleSts, UserPresence, STS_*_DoorStatus, EXT_LGH_ParkingLightCmd");
  Write("  - rbd_bcm_FER_MCore_VMs_217.a2l : MCore variables (if applicable)");
  Write("");
  Write("MISSING SIGNALS (not in databases):");
  Write("─────────────────────────────────");
  Write("• Proxy_write_Power_Unit_Extended - Not found, check A2L/MCore variables");
  Write("• si_sys_TcSen_bTerm* signals      - Not found, may be internal variables");
  Write("• so_sys_F040_KeySts_* (3 variants)- Complex, requires multi-bus signal mapping");
  Write("");
  Write("═══════════════════════════════════════════════════════════════");
  Write("");
}

/*
===============================================================================
  END OF TEST CASE
===============================================================================
*/
